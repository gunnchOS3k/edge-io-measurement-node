## gate1_digital_fabrication/ring_firmware/boards/edge_io_ring/board.yml
```yaml
board:
  name: edge_io_ring
  full_name: Edge I/O Ring EVT0
  vendor: gunnchos
  socs:
    - name: nrf52840
```

## gate1_digital_fabrication/ring_firmware/dts/bindings/azoteq,iqs7222a.yaml
```yaml
# Copyright (c) 2026 gunnchOS3k
# SPDX-License-Identifier: Apache-2.0

description: Azoteq IQS7222A capacitive touch controller

compatible: "azoteq,iqs7222a"

include: [i2c-device.yaml, base.yaml]

properties:
  int-gpios:
    type: phandle-array
    description: Active interrupt GPIO for touch events
```

## gate1_digital_fabrication/ring_firmware/dts/bindings/nxp,se050.yaml
```yaml
# Copyright (c) 2026 gunnchOS3k
# SPDX-License-Identifier: Apache-2.0

description: NXP SE050 secure element (identity/auth digital path)

compatible: "nxp,se050"

include: [i2c-device.yaml, base.yaml]

properties:
  irq-gpios:
    type: phandle-array
    description: SE050 IRQ GPIO
```

## gate1_digital_fabrication/ring_firmware/dts/bindings/qorvo,dw3000.yaml
```yaml
# Copyright (c) 2026 gunnchOS3k
# SPDX-License-Identifier: Apache-2.0

description: Qorvo DW3000 / DWM3001C UWB transceiver

compatible: "qorvo,dw3000"

include: [spi-device.yaml, base.yaml]

properties:
  irq-gpios:
    type: phandle-array
    description: DW3000 IRQ GPIO
  cs-gpios:
    type: phandle-array
    description: Chip-select GPIO (EVT1 candidate P0.20)
```
